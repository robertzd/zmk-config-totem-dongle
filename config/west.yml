## config/west.yml
```yaml
manifest:
  remotes:
    - name: zmkfirmware
      url-base: https://github.com/zmkfirmware
    - name: carrefinho
      url-base: https://github.com/carrefinho
  projects:
    - name: zmk
      remote: zmkfirmware
      revision: 641514a97db345f499dd50b0360e594270f008fe
      import: app/west.yml
    - name: prospector-zmk-module
      remote: carrefinho
      revision: ed98221f3b52b7066dbb10ba3af8a29150b93a5a
  self:
    path: config
```
